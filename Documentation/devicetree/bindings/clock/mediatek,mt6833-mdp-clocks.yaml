## Documentation/devicetree/bindings/clock/mediatek,mt6833-mdp-clocks.yaml
```yaml
# SPDX-License-Identifier: (GPL-2.0-only OR BSD-2-Clause)
%YAML 1.2
---
$id: http://devicetree.org/schemas/clock/mediatek,mt6833-mdp-clocks.yaml#
$schema: http://devicetree.org/meta-schemas/core.yaml#

title: MediaTek MT6833 media data path clocks

maintainers:
  - Dodaskot <pessdres@gmail.com>

description: |
  Clock gates of the MT6833 MDP island. Its inherited power state is
  checked through the SPM syscon before registers are accessed; this
  interface does not implement an unverified island power-switch sequence.

properties:
  compatible:
    const: mediatek,mt6833-mdp-clocks

  reg:
    maxItems: 1

  '#clock-cells':
    const: 1

  clocks:
    maxItems: 1

  clock-names:
    const: bus

  mediatek,spm:
    $ref: /schemas/types.yaml#/definitions/phandle
    description: SPM syscon containing both MDP power status registers

required:
  - compatible
  - reg
  - '#clock-cells'
  - clocks
  - clock-names
  - mediatek,spm

additionalProperties: false
```

## Documentation/devicetree/bindings/display/panel/jdi,hx83112f-a22x.yaml
```yaml
# SPDX-License-Identifier: GPL-2.0-only OR BSD-2-Clause
%YAML 1.2
---
$id: http://devicetree.org/schemas/display/panel/jdi,hx83112f-a22x.yaml#
$schema: http://devicetree.org/meta-schemas/core.yaml#

title: JDI HX83112F C-PHY panel for Samsung Galaxy A22 5G

maintainers:
  - Dodaskot <pessdres@gmail.com>

description: |
  The 1080x2408 LCD uses three C-PHY trios and supports 60 and 90 Hz.
  Panel enable and positive and negative bias rails must be sequenced.
  The reset signal is active low. Touch has its own reset signal.

allOf:
  - $ref: panel-common.yaml#

properties:
  compatible:
    const: jdi,hx83112f-a22x

  reg:
    maxItems: 1

  vdd-supply:
    description: Panel power enable supply

  vsp-supply:
    description: Positive LCD bias supply

  vsn-supply:
    description: Negative LCD bias supply

  reset-gpios:
    maxItems: 1

required:
  - compatible
  - reg
  - vdd-supply
  - vsp-supply
  - vsn-supply
  - reset-gpios
  - port

unevaluatedProperties: false

examples:
  - |
    #include <dt-bindings/gpio/gpio.h>
    dsi {
        #address-cells = <1>;
        #size-cells = <0>;
        panel@0 {
            compatible = "jdi,hx83112f-a22x";
            reg = <0>;
            vdd-supply = <&panel_vdd>;
            vsp-supply = <&panel_vsp>;
            vsn-supply = <&panel_vsn>;
            reset-gpios = <&pio 86 GPIO_ACTIVE_LOW>;
            port {
                panel_in: endpoint {
                    remote-endpoint = <&dsi_out>;
                };
            };
        };
    };
```

## Documentation/devicetree/bindings/input/touchscreen/focaltech,ft8722.yaml
```yaml
# SPDX-License-Identifier: (GPL-2.0-only OR BSD-2-Clause)
%YAML 1.2
---
$id: http://devicetree.org/schemas/input/touchscreen/focaltech,ft8722.yaml#
$schema: http://devicetree.org/meta-schemas/core.yaml#

title: Samsung A22x SPI touchscreen controller variants

description: |
  The A22x SPI touchscreen may use either a Himax HX83112F or FocalTech
  FT8722 controller. Both compatibles may be listed on the same SPI node;
  the drivers use the active panel name in the kernel command line to ensure
  only the matching driver binds.

allOf:
  - $ref: touchscreen.yaml#
  - $ref: /schemas/spi/spi-peripheral-props.yaml#

properties:
  compatible:
    oneOf:
      - const: focaltech,ft8722
      - items:
          - const: himax,hx83112f
          - const: himax,common
          - const: focaltech,ft8722

  reg:
    maxItems: 1

  interrupts:
    maxItems: 1

  interrupts-extended:
    maxItems: 1

  reset-gpios:
    maxItems: 1

  spi-max-frequency: true
  touchscreen-size-x: true
  touchscreen-size-y: true
  touchscreen-inverted-x: true
  touchscreen-inverted-y: true
  touchscreen-swapped-x-y: true

required:
  - compatible
  - reg
  - reset-gpios
  - touchscreen-size-x
  - touchscreen-size-y

oneOf:
  - required:
      - interrupts
  - required:
      - interrupts-extended

unevaluatedProperties: false

examples:
  - |
    #include <dt-bindings/gpio/gpio.h>
    #include <dt-bindings/interrupt-controller/irq.h>
    spi {
      #address-cells = <1>;
      #size-cells = <0>;

      touchscreen@0 {
        compatible = "himax,hx83112f", "himax,common", "focaltech,ft8722";
        reg = <0>;
        spi-max-frequency = <9600000>;
        interrupt-parent = <&gpio>;
        interrupts = <14 IRQ_TYPE_EDGE_FALLING>;
        reset-gpios = <&gpio 15 GPIO_ACTIVE_LOW>;
        touchscreen-size-x = <1080>;
        touchscreen-size-y = <2408>;
      };
    };

...
```

## Documentation/devicetree/bindings/soc/mediatek/mediatek,mt6833-lpm.yaml
```yaml
# SPDX-License-Identifier: (GPL-2.0-only OR BSD-2-Clause)
%YAML 1.2
---
$id: http://devicetree.org/schemas/soc/mediatek/mediatek,mt6833-lpm.yaml#
$schema: http://devicetree.org/meta-schemas/core.yaml#

title: MediaTek MT6833 boot-loaded low-power firmware interface

maintainers:
  - Dodaskot <pessdres@gmail.com>

description: |
  Bring-up interface for the MCUPM firmware loaded by Samsung A226B LK.
  Platform channel 0, policy mailbox 3 and disabled-EEM channel 7 share
  doorbell registers. The original MCUPM controller must stay disabled
  to avoid multiple owners. Shared memory reuses the existing reserved
  MCUPM region; the firmware image itself is not loaded by this interface.
  Deep suspend requires explicit firmware initialization by an administrator.

properties:
  compatible:
    const: mediatek,mt6833-lpm

  reg:
    items:
      - description: LPM mailbox 3
      - description: Platform mailbox 0
      - description: Transmit doorbell set
      - description: Transmit pending bits
      - description: Receive pending clear
      - description: Receive pending bits
      - description: EEM mailbox 7

  reg-names:
    items:
      - const: lpm-mailbox
      - const: platform-mailbox
      - const: tx-set
      - const: tx-status
      - const: rx-clear
      - const: rx-status
      - const: eem-mailbox

  memory-region:
    maxItems: 1
    description: Existing reserved MCUPM shared DRAM, at least 0x110568 bytes

  clocks:
    description: Unused board clocks retained by the bootloader
    minItems: 14
    maxItems: 18

  clock-names:
    minItems: 14
    items:
      - const: boot-uart1
      - const: boot-spi0
      - const: boot-spi3
      - const: boot-spi4
      - const: boot-spi5
      - const: boot-spi6
      - const: boot-spi7
      - const: boot-mdp-rdma0
      - const: boot-mdp-rdma1
      - const: boot-mdp-smi0
      - const: boot-mdp-wrot0
      - const: boot-mdp-wrot1
      - const: boot-mdp-fake0
      - const: boot-mmpll
      - const: boot-ufs
      - const: boot-unipro
      - const: boot-ufs-bclk
      - const: boot-ufs-source

  mediatek,firmware-config:
    $ref: /schemas/types.yaml#/definitions/phandle
    description: |
      Preserved vendor LPM configuration node with irq-remain,
      resource-ctrl and constraints lists. This transitional interface
      reuses Samsung's firmware configuration without enabling its driver.

  mediatek,unused-ufs:
    $ref: /schemas/types.yaml#/definitions/phandle
    description: Disabled UFS controller on an eMMC board with no UFS device

  mediatek,spm:
    $ref: /schemas/types.yaml#/definitions/phandle
    description: SPM syscon providing read-only unused UFS request status

dependencies:
  mediatek,spm: [ 'mediatek,unused-ufs' ]

allOf:
  - if:
      required:
        - mediatek,unused-ufs
    then:
      properties:
        clocks:
          minItems: 18
        clock-names:
          minItems: 18

required:
  - compatible
  - reg
  - reg-names
  - memory-region
  - clocks
  - clock-names
  - mediatek,firmware-config

additionalProperties: false
```

## Documentation/devicetree/bindings/soc/mediatek/mediatek,mt6833-modem-power.yaml
```yaml
# SPDX-License-Identifier: (GPL-2.0-only OR BSD-2-Clause)
%YAML 1.2
---
$id: http://devicetree.org/schemas/soc/mediatek/mediatek,mt6833-modem-power.yaml#
$schema: http://devicetree.org/meta-schemas/core.yaml#

title: MediaTek MT6833 modem power ownership during bring-up

maintainers:
  - Dodaskot <pessdres@gmail.com>

description: |
  Guarded power ownership for the unused modem on the Samsung A22.
  The modem is retained by default. Runtime parking uses the native power
  domain controller; the modem CCIF registers are not accessed.

properties:
  compatible:
    const: mediatek,mt6833-modem-power
  reg:
    maxItems: 1
  power-domains:
    maxItems: 1
  mediatek,spm:
    $ref: /schemas/types.yaml#/definitions/phandle
    description: Always-on SPM syscon used to verify power transitions
  wakeup-source: true

required:
  - compatible
  - reg
  - power-domains
  - mediatek,spm
  - wakeup-source

additionalProperties: false
```

## drivers/net/wireless/mediatek/conn/Kconfig
```kconfig
# SPDX-License-Identifier: GPL-2.0-only

config MTK_COMBO_WIFI
	tristate "MediaTek MT6833 connectivity Wi-Fi"
	depends on ARM64
	depends on WLAN
	depends on CFG80211
	select MMC
	help
	  Build the MediaTek MT6833 connectivity stack, including the WMT
	  controller support required by the Wi-Fi driver and the AXI Wi-Fi
	  driver itself.

	  This is the in-tree form of the A22X vendor connectivity driver.
	  Selecting M builds the connectivity components as kernel modules.
```

## drivers/soc/mediatek/Kconfig
```kconfig
# SPDX-License-Identifier: GPL-2.0-only
#
# MediaTek SoC drivers
#
menu "MediaTek SoC drivers"
	depends on ARCH_MEDIATEK || COMPILE_TEST

config MTK_MT6833_MODEM_POWER
	bool "MediaTek MT6833 guarded modem power ownership"
	depends on PM && PM_GENERIC_DOMAINS && OF
	help
	  Own the unused A22 modem domain through genpd. Keep its boot power
	  state until an administrator explicitly requests runtime parking.

config MTK_MT6833_LPM
	bool "MediaTek MT6833 low-power firmware coordination"
	depends on ARM64 && OF_RESERVED_MEM && SUSPEND && ARM_PSCI_FW && CPU_IDLE
	select MFD_SYSCON
	help
	  Coordinate the boot-loaded MCUPM firmware and provide a guarded
	  vendor CPU_SUSPEND backend on MT6833. Firmware initialization and
	  deep suspend remain explicit administrator opt-ins during bring-up.
	  Suspend-to-idle remains available without firmware initialization.

config MTK_CMDQ
	tristate "MediaTek CMDQ Support"
	depends on ARCH_MEDIATEK || COMPILE_TEST
	select MAILBOX
	select MTK_CMDQ_MBOX
	select MTK_INFRACFG
	help
	  Say yes here to add support for the MediaTek Command Queue (CMDQ)
	  driver. The CMDQ is used to help read/write registers with critical
	  time limitation, such as updating display configuration during the
	  vblank.

config MTK_DEVAPC
	tristate "Mediatek Device APC Support"
	help
	  Say yes here to enable support for Mediatek Device APC driver.
	  This driver is mainly used to handle the violation which catches
	  unexpected transaction.
	  The violation information is logged for further analysis or
	  countermeasures.

config MTK_DVFSRC
	tristate "MediaTek DVFSRC Support"
	depends on ARCH_MEDIATEK
	help
	  Say yes here to add support for the MediaTek Dynamic Voltage
	  and Frequency Scaling Resource Collector (DVFSRC): a HW
	  IP found on many MediaTek SoCs, which is responsible for
	  collecting DVFS requests from various SoC IPs, other than
	  software, and performing bandwidth scaling to provide the
	  best achievable performance-per-watt.

config MTK_INFRACFG
	bool "MediaTek INFRACFG Support"
	select REGMAP
	help
	  Say yes here to add support for the MediaTek INFRACFG controller. The
	  INFRACFG controller contains various infrastructure registers not
	  directly associated to any device.

config MTK_PMIC_WRAP
	tristate "MediaTek PMIC Wrapper Support"
	depends on RESET_CONTROLLER
	depends on OF
	select REGMAP
	help
	  Say yes here to add support for MediaTek PMIC Wrapper found
	  on different MediaTek SoCs. The PMIC wrapper is a proprietary
	  hardware to connect the PMIC.

config MTK_REGULATOR_COUPLER
	bool "MediaTek SoC Regulator Coupler" if COMPILE_TEST
	default ARCH_MEDIATEK
	depends on REGULATOR

config MTK_MMSYS
	tristate "MediaTek MMSYS Support"
	default ARCH_MEDIATEK
	depends on HAS_IOMEM
	depends on MTK_CMDQ || MTK_CMDQ=n
	help
	  Say yes here to add support for the MediaTek Multimedia
	  Subsystem (MMSYS).

config MTK_SVS
	tristate "MediaTek Smart Voltage Scaling(SVS)"
	depends on NVMEM_MTK_EFUSE && NVMEM
	help
	  The Smart Voltage Scaling(SVS) engine is a piece of hardware
	  which has several controllers(banks) for calculating suitable
	  voltage to different power domains(CPU/GPU/CCI) according to
	  chip process corner, temperatures and other factors. Then DVFS
	  driver could apply SVS bank voltage to PMIC/Buck.

config MTK_SOCINFO
	tristate "MediaTek SoC Information"
	default y
	depends on NVMEM_MTK_EFUSE
	select SOC_BUS
	help
	  The MediaTek SoC Information (mtk-socinfo) driver provides
	  information about the SoC to the userspace including the
	  manufacturer name, marketing name and soc name.

endmenu
```
